## raspberrypi3/meta-zee/conf/layer.conf
```bitbake
# We have a conf and classes directory, add to BBPATH
BBPATH .= ":${LAYERDIR}"

# We have recipes-* directories, add to BBFILES
BBFILES += "${LAYERDIR}/recipes-*/*/*.bb \
	${LAYERDIR}/recipes-*/*/*.bbappend"

BBFILE_COLLECTIONS += "yasperzee"
BBFILE_PATTERN_yasperzee = "^${LAYERDIR}/"
BBFILE_PRIORITY_yasperzee = "6"

LAYERSERIES_COMPAT_yasperzee = "thud"
```
